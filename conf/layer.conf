## conf/layer.conf
```bitbake
# We have a conf and classes directory, add to BBPATH
BBPATH .= ":${LAYERDIR}"
 
# We have recipes-* directories, add to BBFILES
BBFILES += "${LAYERDIR}/recipes-*/*/*.bb \
            ${LAYERDIR}/recipes-*/*/*.bbappend"
 
BBFILE_COLLECTIONS += "meta-edgex"
BBFILE_PATTERN_meta-edgex = "^${LAYERDIR}/"
LAYERSERIES_COMPAT_meta-edgex = "zeus"
BBFILE_PRIORITY_meta-edgex = "10"

INHERIT += "edgex-setup"

#TODO: depends meta-openembedded/meta-oe
#TODO: depends meta-openembedded/meta-python
```
